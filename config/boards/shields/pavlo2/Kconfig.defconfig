## config/boards/shields/pavlo2/Kconfig.defconfig
```kconfig
if SHIELD_PAVLO2_LEFT

config ZMK_KEYBOARD_NAME
    default "Pavlo2"

config ZMK_SPLIT_ROLE_CENTRAL
    default y

endif

if SHIELD_PAVLO2_LEFT || SHIELD_PAVLO2_RIGHT

config ZMK_SPLIT
    default y
endif
```

## config/boards/shields/pavlo2/Kconfig.shield
```kconfig
config SHIELD_PAVLO2_LEFT
    def_bool $(shields_list_contains, pavlo2_left)

config SHIELD_PAVLO2_RIGHT
    def_bool $(shields_list_contains, pavlo2_right)
```
